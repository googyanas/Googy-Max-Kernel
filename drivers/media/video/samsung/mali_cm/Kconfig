## drivers/media/video/samsung/mali_cm/Kconfig
```kconfig
#
## S3C Multimedia Mali configuration
##
#
# For Mali
config MALI_CM
	bool "Enable MALI_CM integration"
	depends on VIDEO_SAMSUNG
	default y
	---help---
                This enables MALI integration in the multimedia device driver
```

## drivers/net/wireless/bcmdhd.cm/Kconfig
```kconfig
config BCM4334_CM
	tristate "---Broadcom WiFi Driver for 4334"
	depends on WLAN
	---help---
		Select this option to build Broadcom wlan driver
```
